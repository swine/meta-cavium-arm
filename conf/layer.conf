## conf/layer.conf
```bitbake
# We have a conf and classes directory, add to BBPATH
BBPATH := "${LAYERDIR}:${BBPATH}"
FILESPATH = "${FILE_DIRNAME}/${PF}:${FILE_DIRNAME}/${P}:\
${FILE_DIRNAME}/${PN}:${FILE_DIRNAME}/files:${FILE_DIRNAME}"

BBFILES := "${BBFILES} ${LAYERDIR}/recipes/*/*.bb ${LAYERDIR}/recipes*/*/*.bb"
BBFILES := "${BBFILES} ${LAYERDIR}/recipes/*/*.bbappend ${LAYERDIR}/recipes*/*/*.bbappend"
BBFILE_COLLECTIONS += "cavium"
BBFILE_PATTERN_cavium = "^${LAYERDIR}/"
BBFILE_PRIORITY_cavium = "5"

#DISTRO = "openwrt"
```

## conf/machine/cavium-octeontx-83xx.conf
```bitbake
#@TYPE: Machine
#@NAME: Cavium OcteonTX 83xx

# Backport support for OcteonTx cn81xx/83xx and ThunderX cn88xx
# to yocto-linux-4.8 codebase.
# They're supported natively in linux-4.9.

SERIAL_CONSOLES = "115200;ttyAMA0"

PREFERRED_PROVIDER_virtual/kernel ??= "linux-octeontx-83xx"
PREFERRED_VERSION_linux-yocto ??= "4.8%"

PEFERRED_VERSION_u-boot ?= "v2016.03%"
KERNEL_IMAGETYPE = "Image"

UBOOT_MACHINE = "cn83xx"
UBOOT_ENTRYPOINT = "0x80008000"
UBOOT_LOADADDRESS = "0x80008000"

KERNEL_IMAGETYPE = "Image"
SERIAL_CONSOLES_CHECK ?= "${SERIAL_CONSOLES}"
IMAGE_FSTYPES = " ext4 cpio.gz tar.gz"

MACHINE_FEATURES_append = "pci ext2 serial usbhost vfat "
```

## conf/machine/cavium-thunderx-81xx.conf
```bitbake
#@TYPE: Machine
#@NAME: Cavium ThunderX 88xx

include conf/machine/genericarmv8-ilp32.conf
#
SERIAL_CONSOLES = "115200;ttyAMA0"

PREFERRED_PROVIDER_virtual/kernel ??= "linux-thunderx-81xx"
PREFERRED_VERSION_linux-yocto ??= "4.6"

PEFERRED_VERSION_u-boot ?= "v2016.03%"
KERNEL_IMAGETYPE = "Image"
KERNEL_DEVICETREE = "cavium/thunder-88xx.dtb"
#KERNEL_EXTRA_ARGS += "LOADADDR=${UBOOT_ENTRYPOINT}"

#SPL_BINARY = "MLO"
#UBOOT_SUFFIX = "img"
UBOOT_MACHINE = "thunderx"
UBOOT_ENTRYPOINT = "0x80008000"
UBOOT_LOADADDRESS = "0x80008000"

KERNEL_IMAGETYPE = "Image"
KERNEL_DEVICETREE = "cavium/thunder-81xx.dtb"
SERIAL_CONSOLES_CHECK ?= "${SERIAL_CONSOLES}"
IMAGE_FSTYPES = " ext4 cpio.gz tar.gz"

MACHINE_FEATURES_append = "pci ext2 serial usbhost vfat "
```

## meta-cavium-toolchain/conf/layer.conf
```bitbake
BBPATH .= ":${LAYERDIR}"
BBFILES += "\
            ${LAYERDIR}/recipes-*/*/*.bb \
            ${LAYERDIR}/recipes-*/*/*.bbappend \
           "

#BBFILE_COLLECTIONS += "cavium-toolchain"
#BBFILE_PATTERN_cavium-toolchain := "^${LAYERDIR}/"
#BBFILE_PRIORITY_cavium-toolchain = "30"

# do not error out on bbappends for missing recipes
BB_DANGLINGAPPENDS_WARNONLY = "true"
```
